## main/Kconfig.projbuild
```kconfig
menu "Tailnet Speaker"

    config SPEAKER_SERVER_HOST
        string "Tailnet server host/IP"
        default ""
        help
            Tailscale 100.x IP or MagicDNS host for the controller server.
            Leave empty to boot locally without remote control.

    config SPEAKER_SERVER_PORT
        int "Tailnet server TCP port"
        default 5055
        range 1 65535

    config SPEAKER_DEFAULT_VOLUME
        int "Default speaker volume"
        default 40
        range 0 100

    config SPEAKER_ENABLE_LAN_STATUS_HTTPD
        bool "Enable LAN HTTP status/setup page"
        default y
        help
            Simple status page on the normal Wi-Fi IP. Tailnet control still uses MicroLink TCP.

endmenu
```

## sdkconfig.defaults
```kconfig
# Target
CONFIG_IDF_TARGET="esp32s3"

# ESP32-S3R8 PSRAM for MicroLink buffers + audio queues
CONFIG_SPIRAM=y
CONFIG_SPIRAM_MODE_OCT=y
CONFIG_SPIRAM_SPEED_80M=y
CONFIG_SPIRAM_TRY_ALLOCATE_WIFI_LWIP=y
CONFIG_SPIRAM_MALLOC_ALWAYSINTERNAL=4096
CONFIG_SPIRAM_MALLOC_RESERVE_INTERNAL=32768

# App size / OTA-less large single app
CONFIG_PARTITION_TABLE_SINGLE_APP_LARGE=y

# CPU/FreeRTOS
CONFIG_ESP_DEFAULT_CPU_FREQ_MHZ_240=y
CONFIG_ESP_MAIN_TASK_STACK_SIZE=8192
CONFIG_FREERTOS_HZ=1000
CONFIG_FREERTOS_TIMER_TASK_STACK_DEPTH=4096
CONFIG_ESP_TASK_WDT_TIMEOUT_S=30

# lwIP tuned for WireGuard/TCP audio chunks
CONFIG_LWIP_MAX_SOCKETS=16
CONFIG_LWIP_SO_RCVBUF=y
CONFIG_LWIP_TCPIP_RECVMBOX_SIZE=64
CONFIG_LWIP_TCP_SND_BUF_DEFAULT=32768
CONFIG_LWIP_TCP_WND_DEFAULT=32768
CONFIG_LWIP_IPV4=y
CONFIG_LWIP_IP4_FRAG=y
CONFIG_LWIP_IP4_REASSEMBLY=y

# TLS/crypto needed by MicroLink control plane
CONFIG_ESP_TLS_USING_MBEDTLS=y
CONFIG_MBEDTLS_SSL_PROTO_TLS1_2=y
CONFIG_MBEDTLS_CERTIFICATE_BUNDLE=y
CONFIG_MBEDTLS_CERTIFICATE_BUNDLE_DEFAULT_CMN=y
CONFIG_MBEDTLS_CHACHA20_C=y
CONFIG_MBEDTLS_POLY1305_C=y
CONFIG_MBEDTLS_CHACHAPOLY_C=y
CONFIG_MBEDTLS_HKDF_C=y

# Wi-Fi low-latency tuning for WireGuard/audio traffic
CONFIG_ESP_WIFI_STATIC_RX_BUFFER_NUM=10
CONFIG_ESP_WIFI_DYNAMIC_RX_BUFFER_NUM=32
CONFIG_ESP_WIFI_AMPDU_TX_ENABLED=n
CONFIG_ESP_WIFI_AMPDU_RX_ENABLED=n

# MicroLink: keep peer count and buffers modest for one-server speaker use.
CONFIG_ML_MAX_PEERS=4
CONFIG_ML_NVS_MAX_PEERS=16
CONFIG_ML_H2_BUFFER_SIZE_KB=256
CONFIG_ML_JSON_BUFFER_SIZE_KB=256
CONFIG_ML_ENABLE_CONFIG_HTTPD=n
CONFIG_ML_DEVICE_NAME="waveshare-speaker-2fa9"

# Speaker protocol defaults. Override in sdkconfig.credentials or menuconfig.
CONFIG_SPEAKER_SERVER_HOST=""
CONFIG_SPEAKER_SERVER_PORT=5055
CONFIG_SPEAKER_DEFAULT_VOLUME=40
CONFIG_SPEAKER_ENABLE_LAN_STATUS_HTTPD=y

# Logs
CONFIG_LOG_DEFAULT_LEVEL_INFO=y
```
